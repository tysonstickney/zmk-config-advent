## config/boards/shields/advent/Kconfig.defconfig
```kconfig
# Copyright (c) 2020 The ZMK Contributors
# SPDX-License-Identifier: MIT

if SHIELD_ADVENT_LEFT

config ZMK_KEYBOARD_NAME
	default "Advent"

config ZMK_SPLIT_BLE_ROLE_CENTRAL
	default y

endif

if SHIELD_ADVENT_LEFT || SHIELD_ADVENT_RIGHT

config ZMK_SPLIT
	default y

endif
```

## config/boards/shields/advent/Kconfig.shield
```kconfig
# Copyright (c) 2020 The ZMK Contributors
# SPDX-License-Identifier: MIT

config SHIELD_ADVENT_LEFT
	def_bool $(shields_list_contains,advent_left)

config SHIELD_ADVENT_RIGHT
	def_bool $(shields_list_contains,advent_right)
```

## config/west.yml
```yaml
manifest:
  remotes:
    - name: zmkfirmware
      url-base: https://github.com/zmkfirmware
    - name: petejohanson
      url-base: https://github.com/petejohanson
  projects:
    - name: zmk
      remote: petejohanson
      revision: core/hid-nkro-configurable-support
      revision: ble/hog-characteristic-perm-tweaks-macos
      import: app/west.yml
  self:
    path: config
```
